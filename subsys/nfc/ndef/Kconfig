## subsys/nfc/ndef/Kconfig
```kconfig
#
# Copyright (c) 2017 Nordic Semiconductor ASA
#
# SPDX-License-Identifier: LicenseRef-Nordic-5-Clause
#

if NCS_BM

if NFC_NDEF

config BM_NFC_NDEF_LE_OOB_REC
	bool "NDEF LE OOB record generator library for Bare Metal"
	select NFC_NDEF_PAYLOAD_TYPE_COMMON
	depends on SOFTDEVICE  # TODO add proper dependency

config BM_NFC_NDEF_CH_MSG
	bool "NDEF pairing Connection Handover message generator library for Bare Metal"
	select NFC_NDEF_CH_REC
	help
	  Enable NDEF Connection Handover message generator library

endif # NFC_NDEF

endif # NCS_BM
```
